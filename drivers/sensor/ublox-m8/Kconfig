## drivers/sensor/ublox-m8/Kconfig
```kconfig
# UBLOX_M8 Ublox M8 series gnss modules

# Copyright (c) 2020 Scanimetrics Inc.
# SPDX-License-Identifier: Apache-2.0

menuconfig UBLOX_M8
	bool "UBLOX_M8 M8 series GNSS module"
	depends on I2C
	help
	  Enable driver for ublox I2C M8 series GNSS module.

if UBLOX_M8

module = GNSS
module-str = gnss
source "subsys/logging/Kconfig.template.log_config"

config GNSS_INIT_PRIORITY
	int "Init priority"
	default 90
	help
	  GNSS device driver initialization priority.

config UBLOX_M8_MSG_THREAD_NAME
	string "Thread name"
	default "ublox_msg"
	help
	  Thread name of the ublox m8 driver.

config UBLOX_M8_MSG_THREAD_PRIORITY
	int "Thread priority"
	default 10
	help
	  Priority of thread used by the driver to handle interrupts.

config UBLOX_M8_MSG_THREAD_STACK_SIZE
	int "Thread stack size"
	default 1024
	help
	  Stack size of thread used by the driver to handle interrupts.

config GNSS_SHELL
	bool "Enable gnss shell"
	depends on SHELL
	default y
	help
	  This shell provides access to basic sensor data.

choice
	prompt "Trigger mode"
	default UBLOX_M8_TRIGGER_GLOBAL_THREAD
	help
	  Specify the type of triggering to be used by the driver.

config UBLOX_M8_TRIGGER_NONE
	bool "No trigger"

config UBLOX_M8_TRIGGER_GLOBAL_THREAD
	bool "Use global thread"
	depends on GPIO
	select UBLOX_M8_TRIGGER

config UBLOX_M8_TRIGGER_OWN_THREAD
	bool "Use own thread"
	depends on GPIO
	select UBLOX_M8_TRIGGER

endchoice

config UBLOX_M8_TRIGGER
	bool

config UBLOX_M8_TRIGGER_THREAD_PRIORITY
	int "Thread priority"
	depends on UBLOX_M8_TRIGGER_OWN_THREAD
	default 10
	help
	  Priority of thread used by the driver to handle interrupts.

config UBLOX_M8_TRIGGER_THREAD_STACK_SIZE
	int "Thread stack size"
	depends on UBLOX_M8_TRIGGER_OWN_THREAD
	default 1024
	help
	  Stack size of thread used by the driver to handle interrupts.

config UBLOX_M8_TRIGGER_THREAD_NAME
	string "Thread name"
	default "ublox_txready"
	help
	  Thread name of the ublox m8 driver.

endif # UBLOX_M8
```

## drivers/serial/Kconfig
```kconfig
# Sensor configuration options

# Copyright (c) 2016 Intel Corporation
# SPDX-License-Identifier: Apache-2.0

# Workaround for not being able to have commas in macro arguments
DT_COMPAT_ATMEL_SAM0_DMAC := atmel,sam0-dmac

menu "OOT UART Drivers"

config OOT_UART_SAM0
	bool "Out Of Tree Atmel SAM0 series SERCOM USART driver"
	default n
	depends on SOC_FAMILY_SAM0
	select SERIAL_HAS_DRIVER
	select SERIAL_SUPPORT_INTERRUPT
	# the ASYNC implementation requires a DMA controller
	select SERIAL_SUPPORT_ASYNC if $(dt_compat_enabled,$(DT_COMPAT_ATMEL_SAM0_DMAC))
	select DMA if UART_ASYNC_API
	help
	  This option enables the Out Of Tree SERCOMx USART driver for Atmel SAM0 MCUs.

endmenu

if OOT_UART_SAM0

endif #OOT_UART_SAM0
```

## drivers/timer/Kconfig
```kconfig
# Sensor configuration options

# Copyright (c) 2016 Intel Corporation
# SPDX-License-Identifier: Apache-2.0


menu "OOT Timer Drivers"

config OOT_SAM0_RTC_TIMER
	bool "Out Of Tree Atmel SAM0 series RTC timer"
	depends on SOC_FAMILY_SAM0
	select TICKLESS_CAPABLE
	help
	  This module implements a kernel device driver for the Atmel SAM0
	  series Real Time Counter and provides the standard "system clock
	  driver" interfaces.

endmenu

if OOT_SAM0_RTC_TIMER

endif #OOT_SAM0_RTC_TIMER


endif #SAM0_RTC_TIMER_OOT
```

## dts/bindings/atmel,sam0-gclk.yaml
```yaml
description: ATMEL GCLK (Generic Clock Controller)

compatible: "atmel,sam0-gclk"

include: [clock-controller.yaml, base.yaml]

child-binding:
    description:  GCLK child node
    properties:
        clock-generator:
            type: int
            required: false
            description: generic clock generator

        clock-source:
            type: int
            required: false
            description: generic clock generator source oscillator

        clock-standby:
            type: int
            required: false
            description: generic clock generator run in standby

        clock-divsel:
            type: int
            required: false
            description: generic clock generator divide selection

        clock-div:
            type: int
            required: false
            description: generic clock generator division factor

        clock-frequency:
            type: int
            description: output clock frequency (Hz)
            required: true

        label:
            required: true
            type: string
            description: Human readable string describing the device (used by Zephyr for API name)
```

## dts/bindings/gpio.yaml
```yaml
# Copyright (c) 2020, Scanimetrics Inc.
# SPDX-License-Identifier: Apache-2.0

description: GPIO parent node

compatible: "gpio"

child-binding:
    description: GPIO child node
    properties:
       gpios:
          type: phandle-array
          required: true
       label:
          required: true
          type: string
          description: Human readable string describing the device (used by Zephyr for API name)
```

## dts/bindings/mtd/fram-base.yaml
```yaml
# Copyright (c) 2022 Scanimetrics Inc.
# Copyright (c) 2019 Vestas Wind Systems A/S
# SPDX-License-Identifier: Apache-2.0

# Common fields for FRAM devices

include: base.yaml

properties:
    size:
      type: int
      required: false
      description: Total FRAM size in bytes
    read-only:
      type: boolean
      required: false
      description: Disable writes to the FRAM
    label:
      required: true
```

## dts/bindings/mtd/fram-spi.yaml
```yaml
# Copyright (c) 2022 Scanimetrics Inc.
# Copyright (c) 2019 Vestas Wind Systems A/S
# SPDX-License-Identifier: Apache-2.0

# Common fields for I2C and SPI FRAM devices

include: fram-base.yaml

properties:
    size:
      required: true
    pagesize:
      type: int
      required: true
      description: FRAM page size in bytes
    address-width:
      type: int
      required: true
      description: FRAM address width in bits
    timeout:
      type: int
      required: true
      description: FRAM write cycle timeout in milliseconds
    wp-gpios:
      type: phandle-array
      required: false
      description: |
        GPIO to which the write-protect pin of the chip is connected.

        The device will interpret this signal as active-low.
```

## dts/bindings/mtd/fujitsu,mb85rs.yaml
```yaml
# Copyright (c) 2022 Scanimetrics Inc.
# Copyright (c) 2019 Vestas Wind Systems A/S
# SPDX-License-Identifier: Apache-2.0

description: Fujitsu MB85RS (or compatible) SPI FRAM

compatible: "fujitsu,mb85rs"

include: [fram-spi.yaml, spi-device.yaml]
```

## dts/bindings/mtd/jedec,spi-nand-common.yaml
```yaml
# Copyright (c) 2018 Peter Bigot Consulting, LLC
# Copyright (c) 2019 Nordic Semiconductor ASA
# SPDX-License-Identifier: Apache-2.0

# Common properties used by nodes describing M25P80-compatible SPI NAND
# serial flash devices.

properties:
  jedec-id:
    type: uint8-array
    required: true
    description: JEDEC ID as manufacturer ID, memory type, memory density

  requires-ulbpr:
    type: boolean
    required: false
    description: |
      Indicates the device requires the ULBPR (0x98) command.

      Some flash chips such as the Microchip SST26VF series have a block
      protection register that initializes to write-protected.  Use this
      property to indicate that the BPR must be unlocked before write
      operations can proceed.

  has-dpd:
    type: boolean
    required: false
    description: |
      Indicates the device supports the DPD (0xB9) command.

      Use this property to indicate the flash chip supports the Deep
      Power-Down mode that is entered by command 0xB9 to reduce power
      consumption below normal standby levels.  Use of this property
      implies that the RDPD (0xAB) Release from Deep Power Down command
      is also supported.  (On some chips this command functions as Read
      Electronic Signature; see t-enter-dpd).

  dpd-wakeup-sequence:
    type: array
    required: false
    description: |
      Specifies wakeup durations for devices without RDPD.

      Some devices (Macronix MX25R in particular) wake from deep power
      down by a timed sequence of CSn toggles rather than the RDPD
      command.  This property specifies three durations measured in
      nanoseconds, in this order:
      (1) tDPDD (Delay Time for Release from Deep Power-Down Mode)
      (2) tCDRP (CSn Toggling Time before Release from Deep Power-Down Mode)
      (3) tRDP (Recovery Time for Release from Deep Power-Down Mode)

      Absence of this property indicates that the RDPD command should be
      used to wake the chip from Deep Power-Down mode.

  t-enter-dpd:
    type: int
    required: false
    description: |
      Duration required to complete the DPD command.

      This provides the duration, in nanoseconds, that CSn must be
      remain deasserted after issuing DPD before the chip will enter
      deep power down.

      If not provided the driver does not enforce a delay.

  t-exit-dpd:
    type: int
    required: false
    description: |
      Duration required to complete the RDPD command.

      This provides the duration, in nanoseconds, that CSn must be
      remain deasserted after issuing RDPD before the chip will exit
      deep power down and be ready to receive additional commands.

      If not provided the driver does not enforce a delay.

  size:
    type: int
    required: true
    description: flash capacity in bytes

  page-bytes:
    type: int
    required: true
    description: Size of page in bytes
    
  partial-page-bytes:
    type: int
    required: true
    description: Size of partial page in bytes
    
  sector-bytes:
    type: int
    required: false
    default:  512
    description: Size of sector in bytes
    
  pages-per-block:
    type: int
    required: false
    default:  64
    description: Number of pages per block
    
  blocks:
    type: int
    required: true
    description: Number of blocks
    
  luns:
    type: int
    required: false
    default: 1
    description: Number of logical units per device
    
  max-page-prog-time:
    type: int
    required: true
    description: Maximum page program time
    
  max-page-read-time:
    type: int
    required: true
    description: Maximum page read time
    
  max-block-erase-time:
    type: int
    required: true
    description: Maximum block erase time
    
  page-prog:
    type: int
    required: false
    default: 1
    description: Number of programs per page
    
  spi-transfer-mode:
    type: int
    required: false
    default: 0
    description: |
      Configures the SPI clock polarity CPOL and clock phase CPHA.

      MODE  CPOL  CPHA
        0     0     0
        1     0     1
        2     1     0
        3     1     1

  power-up-wait:
    type: int
    required: true
    description: waiting time for power on tPUW

  tvsl:
    type: int
    required: true
    description: vcc min to cs low tVSL

  parameter-page-address:
    type: int
    required: true
    description: address of parameter page in device data region
```

## dts/bindings/mtd/jedec,spi-nand.yaml
```yaml
# Copyright (c) 2018 Peter Bigot Consulting, LLC
# Copyright (c) 2019 Nordic Semiconductor ASA
# SPDX-License-Identifier: Apache-2.0

description: |
  Properties supporting Zephyr spi-nand flash driver (over the Zephyr SPI
  API) control of serial flash memories using the standard M25P80-based
  command set.

compatible: "jedec,spi-nand"

include: [spi-device.yaml, "jedec,spi-nand-common.yaml"]

properties:
  wp-gpios:
    type: phandle-array
    required: false
    description: WPn pin
  hold-gpios:
    type: phandle-array
    required: false
    description: HOLDn pin
  reset-gpios:
    type: phandle-array
    required: false
    description: RESETn pin
```

## dts/bindings/murata,lora.yaml
```yaml
# Copyright (c) 2020, Scanimetrics Inc.
# SPDX-License-Identifier: Apache-2.0

description: |
    This is a representation of the murata LORA modem.

compatible: "murata,lora"

include: uart-device.yaml

properties:
    label:
      required: true

    mdm-reset-gpios:
      type: phandle-array
      required: true
      description: MCU RESETn pin

    mdm-rf-irq-gpios:
      type: phandle-array
      required: false
      description: IRQ pin

    mdm-boot0-gpios:
      type: phandle-array
      required: false
      description: BOOT0 pin

    mdm-rf-ssn-gpios:
      type: phandle-array
      required: false
      description: CSn pin

    mdm-sck-gpios:
      type: phandle-array
      required: false
      description: SCK pin

    mdm-mosi-tx-gpios:
      type: phandle-array
      required: false
      description: TXD pin

    mdm-miso-rx-gpios:
      type: phandle-array
      required: false
      description: RXD pin
```

## dts/bindings/scanimetrics,samd2x-gclkgen.yaml
```yaml
#
# Copyright (c) 2020 Scanimetrics Inc.
# SPDX-License-Identifier: Apache-2.0
#

description: Atmel SAMD2x GCLK Generator

compatible: "scanimetrics,samd2x-gclkgen"

include: [clock-controller.yaml, base.yaml]

properties:
    clock-frequency:
        type: int
        required:  false
        description:  generic clock generator frequency

    div:
        type: int
        required: false
        description: generic clock generator division factor

    runstdby:
        type: int
        required: false
        description: generic clock generator run in standby

    divsel:
        type: int
        required: false
        description: generic clock generator divide selection

    "#clock-cells":
      const: 1

clock-cells:
  - clkctrl_id
```

## dts/bindings/scanimetrics,samd5x-dfll.yaml
```yaml
#
# Copyright (c) 2020 Scanimetrics Inc.
# SPDX-License-Identifier: Apache-2.0
#

description: ATMEL Oscillator (DFLL Controller)

compatible: "scanimetrics,samd5x-dfll"

include: [clock-controller.yaml, base.yaml]

properties:
    status:
        type: string
        required: false
        description: indicates the operational status of a oscillator
        enum:
           - "okay"
           - "disabled"

    clock-frequency:
        type: int
        description:  dfll frequency

    runstdby:
        type: int
        required: false
        description:  dfll runstdby

clock-cells:
  - source_osc
```

## dts/bindings/scanimetrics,samd5x-dpll.yaml
```yaml
#
# Copyright (c) 2020 Scanimetrics Inc.
# SPDX-License-Identifier: Apache-2.0
#

description: ATMEL Oscillator (Oscillator Controller)

compatible: "scanimetrics,samd5x-osc"

include: [clock-controller.yaml, base.yaml]

properties:
    status:
        type: string
        required: false
        description: indicates the operational status of a oscillator
        enum:
           - "okay"
           - "disabled"

    clock-frequency:
        type: int
        description:  dpll frequency

    runstdby:
        type: int
        required: false
        description:  dpll runstdby

clock-cells:
  - source_osc
```

## dts/bindings/scanimetrics,samd5x-gclkgen.yaml
```yaml
#
# Copyright (c) 2020 Scanimetrics Inc.
# SPDX-License-Identifier: Apache-2.0
#

description: Atmel SAMD5x GCLK Generator

compatible: "scanimetrics,samd5x-gclkgen"

include: [clock-controller.yaml, base.yaml]

properties:
    clock-frequency:
        type: int
        required:  false
        description:  generic clock generator frequency

    clock-div:
        type: int
        required: false
        description: generic clock generator division factor

    runstdby:
        type: int
        required: false
        description: generic clock generator run in standby

    clock-divsel:
        type: int
        required: false
        description: generic clock generator divide selection

    "#clock-cells":
      const: 1

clock-cells:
  - periph_ch
```
