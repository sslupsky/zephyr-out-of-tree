## dts/bindings/scanimetrics,samd5x-xosc.yaml
```yaml
#
# Copyright (c) 2020 Scanimetrics Inc.
# SPDX-License-Identifier: Apache-2.0
#

description: ATMEL Oscillator (Oscillator Controller)

compatible: "scanimetrics,samd5x-xosc"

include: [clock-controller.yaml, base.yaml]

properties:
    status:
        type: string
        required: false
        description: indicates the operational status of a oscillator
        enum:
           - "okay"
           - "disabled"

    clock-frequency:
        type: int
        description:  crystal oscillator frequency

    runstdby:
        type: int
        required: false
        description:  oscillator runstdby

clock-cells:
  - source_osc
```

## dts/bindings/ti,ads1115.yaml
```yaml
# Copyright (c) 2020, Scanimetrics Inc.
# SPDX-License-Identifier: Apache-2.0

description: Texas Instruments ADS1115

compatible: "ti,ads1115"

include: ti,ads111x-base.yaml
```

## dts/bindings/ti,ads111x-base.yaml
```yaml
# Common fields for Texas Instruments ADS111X

include: [adc-controller.yaml, i2c-device.yaml]

properties:
    "#io-channel-cells":
      const: 1

io-channel-cells:
    - channel

properties:
    alert-gpios:
      type: phandle-array
      required: false
      description: |
        ALERT pin.

        This pin signals active high when produced by the sensor.  The
        property value should ensure the flags properly describe the
        signal that is presented to the driver.
```

## dts/bindings/ti,bq24195.yaml
```yaml
# Copyright (c) 2020, Scanimetrics Inc.
# SPDX-License-Identifier: Apache-2.0
# Texas Instruments BQ24195

description: |
    This is a representation of the Texas Instruments BQ24195 PMIC.

compatible: "ti,bq24195"

include: i2c-device.yaml

properties:
    irq-gpios:
        type: phandle-array
        required: false
        description: |
            INT pin.

            This pin signals active high when produced by the pmic.  The
            property value should ensure the flags properly describe the
            signal that is presented to the driver.
```

## dts/bindings/ti,opt3001.yaml
```yaml
# Copyright (c) 2019, Actinius
# SPDX-License-Identifier: Apache-2.0

description: Texas Instruments OPT3001 ambient light sensor

compatible: "ti,opt3001-oot"

include: i2c-device.yaml

properties:
    int-gpios:
        type: phandle-array
        required: false
        description: |
            INT pin.

            The active state produced by the sensor depends on the POL setting.
            The property value should ensure the flags properly describe the
            signal that will be presented to the driver.
```

## dts/bindings/ublox,m8.yaml
```yaml
# Copyright (c) 2020, Scanimetrics Inc.
# SPDX-License-Identifier: Apache-2.0

description: |
    Ublox M8 M8 series GNSS modules
    This binding provides a representation of the Ublox M8 series gnss module.
    The module is interfaced using i2c bus.

compatible: "ublox,m8"

include: i2c-device.yaml

properties:
    label:
      required: true

    txready-gpios:
      type: phandle-array
      required: false
      description: |
          The TX_READY function is used to indicate when the receiver has data
          to transmit on DDC interface.
          A listener can wait on the TX_READY signal instead of polling the
          DDC interfaces. 
          The TX_READY function can be mapped to TXD (PIO 06).
          The TX_READY function is disabled by default.
          Reference doc: UBX-16018358 - R06
          Section: 1.4.2

    reset-gpios:
      type: phandle-array
      required: true
      description: |
          Driving RESET_N low activates a hardware reset of the system.
          Use this pin only to reset the module.
          Do not use RESET_N to turn the module on and off,
          since the reset state increases power consumption.
          The SAM-M8Q RESET_N pin is for input only.
          Reference doc: UBX-16018358 - R06
          Section: 1.5.1


    extint-gpios:
      type: phandle-array
      required: false
      description: |
          EXTINT is an external interrupt pin.
          It can be used for wake-up functions in Power Save Mode
          and for aiding.
          Function is disabled by default.
          If EXTINT is not used for an external interrupt function,
          the pin can be used as a generic PIO (PIO13).
          PIO13 can be configured to function as an output pin for
          the TXD Ready feature to indicate that the receiver has data
          to transmit.
          Reference doc: UBX-16018358 - R06
          Section: 1.5.2

    safeboot-gpios:
      type: phandle-array
      required: false
      description: |
          The SAFEBOOT_N pin is for future service, updates and reconfiguration.
          Reference doc: UBX-16018358 - R06
          Section: 1.5.2

    timepulse-gpios:
      type: phandle-array
      required: false
      description: |
          A configurable time pulse signal. By default, the time pulse
          signal is configured to one pulse per second.
          Reference doc: UBX-16018358 - R06
          Section: 1.5.3

    txd-gpios:
      type: phandle-array
      required: false
      description: |
          UART TXD
          Reference doc: UBX-16018358 - R06
          Section: 1.4.1

    rxd-gpios:
      type: phandle-array
      required: false
      description: |
          UART RXD
          Reference doc: UBX-16018358 - R06
          Section: 1.4.1
```

## witap/Kconfig
```kconfig
# WiTAP configuration options

# Copyright (c) 2020 Scanimetrics Inc.
# SPDX-License-Identifier: Apache-2.0

module = WITAP
module-str = witap
source "subsys/logging/Kconfig.template.log_config"

config WITAP
	bool "WiTAP module"
	depends on I2C
	help
	  Enable WITAP module.

config WITAP_LOG_BACKEND
	bool "Log backend log to file"
	help
	  Enable Logging to file.

if WITAP
endif # WITAP
```
