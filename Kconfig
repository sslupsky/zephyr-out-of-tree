## Kconfig
```kconfig
# ICM20649 Six-Axis Motion Tracking device configuration options

# Copyright (c) 2016 Intel Corporation
# SPDX-License-Identifier: Apache-2.0

menuconfig ICM20649
	bool "ICM20649 Six-Axis Motion Tracking Device"
	depends on I2C
	help
	  Enable driver for ICM20649 I2C-based six-axis motion tracking device.

if ICM20649

config ICM20649_NAME
	string "Driver name"
	default "ICM20649"
	help
	  Device name with which the ICM20649 sensor is identified.

config ICM20649_I2C_ADDR
	hex "I2C address"
	default 0x68
	range 0x68 0x69
	help
	  I2C address of the ICM20649 sensor.
	  Choose 0x68 if the AD0 pin is pulled to GND or 0x69 if the AD0 pin
	  is pulled to VDD.

config ICM20649_I2C_MASTER_DEV_NAME
	string "I2C master where ICM20649 is connected"
	default "I2C_0"
	help
	  Specify the device name of the I2C master device to which ICM20649 is
	  connected.

choice
	prompt "Trigger mode"
	default ICM20649_TRIGGER_GLOBAL_THREAD
	help
	  Specify the type of triggering to be used by the driver.

config ICM20649_TRIGGER_NONE
	bool "No trigger"

config ICM20649_TRIGGER_GLOBAL_THREAD
	bool "Use global thread"
	depends on GPIO
	select ICM20649_TRIGGER

config ICM20649_TRIGGER_OWN_THREAD
	bool "Use own thread"
	depends on GPIO
	select ICM20649_TRIGGER

endchoice

config ICM20649_TRIGGER
	bool

config ICM20649_GPIO_DEV_NAME
	string "GPIO device"
	default "GPIO_0"
	depends on ICM20649_TRIGGER
	help
	  The device name of the GPIO device to which the ICM20649 interrupt pin
	  is connected.

config ICM20649_GPIO_PIN_NUM
	int "Interrupt GPIO pin number"
	default 0
	depends on ICM20649_TRIGGER
	help
	  The number of the GPIO on which the interrupt signal from the ICM20649
	  chip will be received.

config ICM20649_THREAD_PRIORITY
	int "Thread priority"
	depends on ICM20649_TRIGGER_OWN_THREAD
	default 10
	help
	  Priority of thread used by the driver to handle interrupts.

config ICM20649_THREAD_STACK_SIZE
	int "Thread stack size"
	depends on ICM20649_TRIGGER_OWN_THREAD
	default 1024
	help
	  Stack size of thread used by the driver to handle interrupts.

config ICM20649_ACCEL_FS
	int "Accelerometer full-scale range"
	default 2
	help
	  Magnetometer full-scale range.
	  An X value for the config represents a range of +/- X g. Valid
	  values are 2, 4, 8 and 16.

config ICM20649_GYRO_FS
	int "Gyroscope full-scale range"
	default 250
	help
	  Gyroscope full-scale range.
	  An X value for the config represents a range of +/- X degrees/second.
	  Valid values are 250, 500, 1000, 2000.

endif # ICM20649
```

## Kconfig.defconfig
```kconfig
# Scanimetrics WiTAP ISB board configuration

# Copyright (c) 2017 Google LLC.
# SPDX-License-Identifier: Apache-2.0

if BOARD_SCANIMETRICS_WITAP_ISB

config BOARD
	default "scanimetrics_witap_isb"

endif # BOARD_SCANIMETRICS_WITAP_ISB
```

## boards/arm/arduino_mkr_1310/Kconfig.board
```kconfig
# Arduino MKR 1310 configuration

# Copyright (c) 2017 Google LLC.
# SPDX-License-Identifier: Apache-2.0

config BOARD_ARDUINO_MKR_1310
	bool "Arduino MKR 1310"
	depends on SOC_PART_NUMBER_SAMD21G18A
```

## boards/arm/arduino_mkr_1310/Kconfig.defconfig
```kconfig
# Arduino MKR 1310 board configuration

# Copyright (c) 2017 Google LLC.
# SPDX-License-Identifier: Apache-2.0

config BOARD
	default "arduino_mkr_1310"
	depends on BOARD_ARDUINO_MKR_1310
```

## boards/arm/arduino_mkr_1310/arduino_mkr_1310_defconfig
```kconfig
# SPDX-License-Identifier: Apache-2.0

CONFIG_ARM=y
CONFIG_SOC_FAMILY_SAM0=y
CONFIG_SOC_SERIES_SAMD21=y
CONFIG_SOC_PART_NUMBER_SAMD21G18A=y
CONFIG_BOARD_ARDUINO_MKR_1310=y
CONFIG_USE_CODE_PARTITION=y
CONFIG_SOC_ATMEL_SAMD_XOSC32K=y
CONFIG_SOC_ATMEL_SAMD_XOSC32K_AS_MAIN=y
CONFIG_CORTEX_M_SYSTICK=n
CONFIG_SAM0_RTC_TIMER=y
CONFIG_SYS_CLOCK_HW_CYCLES_PER_SEC=32768

# TICKS_PER_SEC must be a factor of CYCLES_PER_SEC
# otherwise there is an accumulating time error
# For some reason, TICKS_PER_SEC values of 2048 and 4096
# do not work.  I am not sure why at this point.
CONFIG_SYS_CLOCK_TICKS_PER_SEC=1024

CONFIG_SYS_POWER_MANAGEMENT=y
CONFIG_SYS_POWER_SLEEP_STATES=y
#CONFIG_SYS_PM_MIN_RESIDENCY_SLEEP_1=2
#CONFIG_SYS_PM_MIN_RESIDENCY_SLEEP_2=10
CONFIG_CONSOLE=y
CONFIG_UART_CONSOLE=y
CONFIG_USB_UART_CONSOLE=y
CONFIG_SERIAL=y
CONFIG_UART_SAM0=y
CONFIG_UART_INTERRUPT_DRIVEN=y
CONFIG_GPIO=y
CONFIG_GPIO_SAM0=y
CONFIG_WATCHDOG=y
CONFIG_WDT_SAM0=y
CONFIG_PINMUX=y
CONFIG_PINMUX_SAM0=y
CONFIG_USB=y
CONFIG_USB_DC_SAM0=y
CONFIG_SPI=y
CONFIG_SPI_SAM0=y
CONFIG_I2C=y
```

## boards/arm/arduino_mkr_1500/Kconfig.board
```kconfig
# Arduino MKR 1500 configuration

# Copyright (c) 2017 Google LLC.
# SPDX-License-Identifier: Apache-2.0

config BOARD_ARDUINO_MKR_1500
	bool "Arduino MKR 1500"
	depends on SOC_PART_NUMBER_SAMD21G18A
```

## boards/arm/arduino_mkr_1500/Kconfig.defconfig
```kconfig
# Arduino MKR 1500 board configuration

# Copyright (c) 2017 Google LLC.
# SPDX-License-Identifier: Apache-2.0

if BOARD_ARDUINO_MKR_1500

config BOARD
	default "arduino_mkr_1500"

endif # BOARD_ARDUINO_MKR_1500
```

## boards/arm/scanimetrics_witap_isb/Kconfig.board
```kconfig
# Scanimetrics WiTAP ISB configuration

# Copyright (c) 2017 Google LLC.
# SPDX-License-Identifier: Apache-2.0

config BOARD_SCANIMETRICS_WITAP_ISB
	bool "Scanimetrics WiTAP ISB"
	depends on SOC_PART_NUMBER_SAMD21J18A
	select SYS_POWER_MANAGEMENT
```

## boards/arm/scanimetrics_witap_isb/Kconfig.defconfig
```kconfig
# Scanimetrics WiTAP ISB board configuration

# Copyright (c) 2017 Google LLC.
# SPDX-License-Identifier: Apache-2.0

config BOARD
	default "scanimetrics_witap_isb"
	depends on BOARD_SCANIMETRICS_WITAP_ISB
```

## boards/arm/scanimetrics_witap_isb/scanimetrics_witap_isb_defconfig
```kconfig
# SPDX-License-Identifier: Apache-2.0

CONFIG_SOC_SERIES_SAMD21=y
CONFIG_SOC_PART_NUMBER_SAMD21J18A=y
CONFIG_BOARD_SCANIMETRICS_WITAP_ISB=y
CONFIG_USE_DT_CODE_PARTITION=y
CONFIG_SOC_ATMEL_SAMD_XOSC32K=y
CONFIG_SOC_ATMEL_SAMD_XOSC32K_AS_MAIN=y
CONFIG_CORTEX_M_SYSTICK=n
CONFIG_SAM0_RTC_TIMER=n
CONFIG_OOT_SAM0_RTC_TIMER=y

# TICKS_PER_SEC must be a factor of CYCLES_PER_SEC
# otherwise there is an accumulating time error
# Worst case rtc sync busy time is about 360us
# So, max TICKS_PER_SEC=2048
# However, it appears there is a start up time
# maybe related to the DFLL that is causing
# instability when using a tick rate faster
# than 1024
CONFIG_SYS_CLOCK_TICKS_PER_SEC=1024

CONFIG_CONSOLE=y
CONFIG_UART_CONSOLE=y
CONFIG_USB_UART_CONSOLE=y
CONFIG_SERIAL=y
CONFIG_UART_SAM0=y
CONFIG_UART_INTERRUPT_DRIVEN=y
CONFIG_GPIO=y
CONFIG_GPIO_SAM0=y
CONFIG_WATCHDOG=y
CONFIG_WDT_SAM0=y
CONFIG_SPI=n
CONFIG_SPI_SAM0=n
CONFIG_PINMUX=y
CONFIG_PINMUX_SAM0=y
CONFIG_USB=y
CONFIG_USB_DC_SAM0=y
```

## boards/arm/scanimetrics_witap_isb_v2/Kconfig.board
```kconfig
# Scanimetrics WiTAP ISB configuration

# Copyright (c) 2017 Google LLC.
# SPDX-License-Identifier: Apache-2.0

config BOARD_SCANIMETRICS_WITAP_ISB_V2
	bool "Scanimetrics WiTAP ISB V2"
	depends on SOC_PART_NUMBER_SAMD51J20A
```

## boards/arm/scanimetrics_witap_isb_v2/Kconfig.defconfig
```kconfig
# Scanimetrics WiTAP ISB board configuration

# Copyright (c) 2017 Google LLC.
# SPDX-License-Identifier: Apache-2.0

config BOARD
	default "scanimetrics_witap_isb_v2"
	depends on BOARD_SCANIMETRICS_WITAP_ISB_V2
```

## boards/arm/scanimetrics_witap_isb_v2/scanimetrics_witap_isb_defconfig
```kconfig
# SPDX-License-Identifier: Apache-2.0

#CONFIG_ARM=y
#CONFIG_SOC_FAMILY_SAM0=y
CONFIG_SOC_SERIES_SAMD51=y
CONFIG_SOC_PART_NUMBER_SAMD51J20A=y
CONFIG_BOARD_SCANIMETRICS_WITAP_ISB_V2=y
CONFIG_USE_DT_CODE_PARTITION=y
CONFIG_SOC_ATMEL_SAMD_XOSC32K=y
CONFIG_SOC_ATMEL_SAMD_XOSC32K_AS_MAIN=y
CONFIG_CORTEX_M_SYSTICK=n
CONFIG_SAM0_RTC_TIMER=y
CONFIG_SYS_CLOCK_HW_CYCLES_PER_SEC=32768

# TICKS_PER_SEC must be a factor of CYCLES_PER_SEC
# otherwise there is an accumulating time error
# Worst case rtc sync busy time is about 360us
# So, max TICKS_PER_SEC=2048
# However, it appears there is a start up time
# maybe related to the DFLL that is causing
# instability when using a tick rate faster
# than 1024
CONFIG_SYS_CLOCK_TICKS_PER_SEC=1024

CONFIG_SYS_POWER_MANAGEMENT=y
CONFIG_SYS_POWER_SLEEP_STATES=y
#CONFIG_SYS_PM_MIN_RESIDENCY_SLEEP_1=2
#CONFIG_SYS_PM_MIN_RESIDENCY_SLEEP_2=10
CONFIG_CONSOLE=y
CONFIG_UART_CONSOLE=y
CONFIG_USB_UART_CONSOLE=y
CONFIG_SERIAL=y
CONFIG_UART_SAM0=y
CONFIG_UART_INTERRUPT_DRIVEN=y
CONFIG_GPIO=y
CONFIG_GPIO_SAM0=y
CONFIG_WATCHDOG=y
CONFIG_WDT_SAM0=y
CONFIG_SPI=n
CONFIG_SPI_SAM0=n
CONFIG_PINMUX=y
CONFIG_PINMUX_SAM0=y
CONFIG_USB=y
CONFIG_USB_DC_SAM0=y
```

## drivers/Kconfig
```kconfig
# out of tree drivers configuration options

# Copyright (c) 2015 Intel Corporation
# SPDX-License-Identifier: Apache-2.0

menu "Device Drivers"

rsource "flash/Kconfig"
rsource "modem/Kconfig"
rsource "sensor/Kconfig"
rsource "adc/Kconfig"
rsource "timer/Kconfig"
rsource "i2c/Kconfig"
rsource "serial/Kconfig"

endmenu
```

## drivers/adc/Kconfig
```kconfig
# ADC configuration options

# Copyright (c) 2015 Intel Corporation
# SPDX-License-Identifier: Apache-2.0

#
# ADC options
#


rsource "Kconfig.ads111x"
```

## drivers/adc/Kconfig.ads111x
```kconfig
# ADS111x ADC configuration options

# Copyright (c) 2020 Scanimetrics Inc.
# SPDX-License-Identifier: Apache-2.0

config ADC_ADS111X
	bool "ADS111x driver"
	depends on I2C
	help
	  Enable ADS111x ADC driver.

	  The ADS111x are 2/4 channel 16-bit A/D converters
	  with I2C interface.

if ADC_ADS111X

config ADC_ADS111X_INIT_PRIORITY
	int "Init priority"
	default 80
	help
	  ADS111x ADC device driver initialization priority.

config ADC_ADS111X_ACQUISITION_THREAD_STACK_SIZE
	int "Stack size for the ADC data acquisition thread"
	default 512
	help
	  Size of the stack used for the internal data acquisition
	  thread.

config ADC_ADS111X_ACQUISITION_THREAD_PRIO
	int "Priority for the ADC data acquisition thread"
	default 0
	help
	  Priority level for the internal ADC data acquisition thread.

endif # ADC_ADS111X
```

## drivers/flash/Kconfig
```kconfig
# Modem configuration options

# Copyright (c) 2018 Foundries.io
# SPDX-License-Identifier: Apache-2.0

menu "OOT Flash Drivers"

rsource "Kconfig.nand"

endmenu # FLASH
```

## drivers/fram/Kconfig
```kconfig
# FRAM configuration options

# Copyright (c) 2022 Scanimetrics Inc.
# SPDX-License-Identifier: Apache-2.0

menu "OOT FRAM Drivers"

rsource "Kconfig.fram"

endmenu # FRAM
```

## drivers/fram/Kconfig.fram
```kconfig
# Copyright (c) 2022 Scanimetrics Inc.
# SPDX-License-Identifier: Apache-2.0

menuconfig FRAM
	bool "FRAM hardware support"
	depends on SPI
	help
	  Enable support for FRAM hardware.

if FRAM

module = FRAM
module-str = fram
source "subsys/logging/Kconfig.template.log_config"

config FRAM_MB85RS
	bool "Fujitsu MB85RS (and compatible) SPI FRAM support"
	depends on SPI
	select FRAM
	help
	  Enable support for Fujitsu MB85RS (and compatible) SPI FRAMs.

config FRAM_INIT_PRIORITY
	int
	default 80
	help
	  Device driver initialization priority.
	  Device is connected to SPI bus, it has to
	  be initialized after SPI driver.

config FRAM_CS_WAIT_DELAY
	int "Delay time in us"
	default 0
	help
	  This is the wait delay (in us) to allow for CS switching to take effect

config FRAM_IDLE_IN_DPD
	bool "Use Deep Power-Down mode when flash is not being accessed."
	help
	  Where supported deep power-down mode can reduce current draw
	  to as little as 0.1% of standby current.  However it takes
	  some milliseconds to enter and exit from this mode.

	  Select this option for applications where device power
	  management is not enabled, the flash remains inactive for
	  long periods, and when used the impact of waiting for mode
	  enter and exit delays is acceptable.

config FRAM_SHELL
	bool "Enable FRAM shell"
	depends on SHELL
	default y
	help
	  This shell provides access to basic device data.

config FRAM_SHELL_BUFFER_SIZE
	int "FRAM shell buffer size"
	default 256
	depends on FRAM_SHELL
	help
	  Size of the buffer used for FRAM read/write commands in
	  the FRAM shell.

endif # FRAM
```

## drivers/i2c/Kconfig
```kconfig
# Sensor configuration options

# Copyright (c) 2016 Intel Corporation
# SPDX-License-Identifier: Apache-2.0


menu "OOT I2C Drivers"

config OOT_I2C_SAM0
	bool "Out Of Tree Atmel SAM0 series I2C SERCOM driver"
	depends on SOC_FAMILY_SAM0
	help
	  Enable the Out Of Tree Atmel SAM0 series I2C SERCOM driver.

config I2C_SAM0_DMA_DRIVEN
	bool "Enable DMA support for SAM0 I2C devices"
	depends on OOT_I2C_SAM0
	select DMA
	help
	  This enables DMA driven transactions for the I2C peripheral.
	  DMA driven mode requires fewer interrupts to handle the
	  transaction and ensures that high speed modes are not delayed
	  by data reloading.

endmenu

if OOT_I2C_SAM0

endif #OOT_I2C_SAM0
```

## drivers/modem/Kconfig
```kconfig
# Modem configuration options

# Copyright (c) 2018 Foundries.io
# SPDX-License-Identifier: Apache-2.0

menuconfig OOT_MODEM
	bool "Modem Out-of-Tree Drivers"
	help
	  Enable config options for modem out-of-tree drivers.

if OOT_MODEM

# module = MODEM
# module-str = modem
# source "subsys/logging/Kconfig.template.log_config"

rsource "Kconfig.murata-lora-cmwx1zzabz"

endif # OOT_MODEM
```

## drivers/modem/Kconfig.murata-lora-cmwx1zzabz
```kconfig
# murata LORA CMWX1ZZABZ driver options

# Copyright (c) 2020 Scanimetrics Inc.
# SPDX-License-Identifier: Apache-2.0

config MODEM_MURATA_LORA
	bool "Enable murata LORA modem driver"
	select MODEM_CONTEXT
	select MODEM_CMD_HANDLER
	select MODEM_IFACE_UART
	# select MODEM_SOCKET
	imply GPIO
	help
	  Choose this setting to enable murata LORA modem
	  driver.

if MODEM_MURATA_LORA

config MODEM_MURATA_LORA_NAME
	string "Driver name"
	default "MODEM_LORA"

config MODEM_MURATA_LORA_RX_STACK_SIZE
	int "Stack size for the murata LORA modem driver RX thread"
	default 1024
	help
	  This stack is used by the murata LORA RX thread.

config MODEM_MURATA_LORA_RX_WORKQ_STACK_SIZE
	int "Stack size for the murata LORA modem driver work queue"
	default 2048
	help
	  This stack is used by the work queue to pass off net_pkt data
	  to the rest of the network stack, letting the rx thread continue
	  processing data.

config MODEM_MURATA_LORA_APN
	string "APN for establishing network connection"
	default "hologram"
	help
	  This setting is used in the AT+CGDCONT command to set the APN name
	  for the network connection context.  This value is specific to
	  the network provider and may need to be changed.

config MODEM_MURATA_LORA_OTAA
	string "establishing network connection using OTAA"
	help
	  This setting is used to set the join method to OTAA.

config MODEM_MURATA_LORA_ABP
	string "establishing network connection using ABP"
	help
	  This setting is used to set the join method to ABP.

config MODEM_MURATA_LORA_INIT_PRIORITY
	int "murata LORA driver init priority"
	default 80
	help
	  murata LORA device driver initialization priority.
	  Do not mess with it unless you know what you are doing.
	  Note that the priority needs to be lower than the net stack
	  so that it can start before the networking sub-system.

endif # MODEM_MURATA_LORA
```

## drivers/sensor/Kconfig
```kconfig
# Sensor configuration options

# Copyright (c) 2016 Intel Corporation
# SPDX-License-Identifier: Apache-2.0


menu "OOT Sensor Drivers"

rsource "icm20649/Kconfig"
rsource "bq24195/Kconfig"
rsource "ublox-m8/Kconfig"
rsource "opt3001/Kconfig"

endmenu
```
