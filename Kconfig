## drivers/sensor/bq24195/Kconfig
```kconfig
# BQ24195 Texas Instruments I2C Controlled 2.5-A /4.5-A Single Cell USB/Adapter Charger

# Copyright (c) 2020 Scanimetrics Inc.
# SPDX-License-Identifier: Apache-2.0

menuconfig BQ24195
	bool "BQ24195 Power Management Controller"
	depends on I2C
	help
	  Enable driver for BQ24195 I2C Controlled 2.5-A /4.5-A Single Cell USB/Adapter Charger.

if BQ24195

config BQ24195_NAME
	string "Driver name"
	default "BQ24195"
	help
	  Device name with which the BQ24195 sensor is identified.

config BQ24195_I2C_ADDR
	hex "I2C address"
	default 0x6B
	help
	  I2C address of the BQ24195 sensor is fixed to 0x6B.

config BQ24195_I2C_MASTER_DEV_NAME
	string "I2C master where BQ24195 is connected"
	default "SERCOM0"
	help
	  Specify the device name of the I2C master device to which BQ24195 is
	  connected.

choice
	prompt "Trigger mode"
	default BQ24195_TRIGGER_GLOBAL_THREAD
	help
	  Specify the type of triggering to be used by the driver.

config BQ24195_TRIGGER_NONE
	bool "No trigger"

config BQ24195_TRIGGER_GLOBAL_THREAD
	bool "Use global thread"
	depends on GPIO
	select BQ24195_TRIGGER

config BQ24195_TRIGGER_OWN_THREAD
	bool "Use own thread"
	depends on GPIO
	select BQ24195_TRIGGER

endchoice

config BQ24195_TRIGGER
	bool

config BQ24195_GPIO_DEV_NAME
	string "GPIO device"
	default "GPIO_0"
	depends on BQ24195_TRIGGER
	help
	  The device name of the GPIO device to which the BQ24195 interrupt pin
	  is connected.

config BQ24195_GPIO_PIN_NUM
	int "Interrupt GPIO pin number"
	default 0
	depends on BQ24195_TRIGGER
	help
	  The number of the GPIO on which the interrupt signal from the BQ24195
	  chip will be received.

config BQ24195_THREAD_PRIORITY
	int "Thread priority"
	depends on BQ24195_TRIGGER_OWN_THREAD
	default 10
	help
	  Priority of thread used by the driver to handle interrupts.

config BQ24195_THREAD_STACK_SIZE
	int "Thread stack size"
	depends on BQ24195_TRIGGER_OWN_THREAD
	default 1024
	help
	  Stack size of thread used by the driver to handle interrupts.

endif # BQ24195
```

## drivers/sensor/opt3001/Kconfig
```kconfig
# OPT3001 light sensor configuration options

# Copyright (c) 2019 Actinius
# SPDX-License-Identifier: Apache-2.0

config OPT3001_OOT
	bool "Out Of Tree OPT3001 Light Sensor"
	depends on (I2C && HAS_DTS_I2C)
	help
	  Enable driver for OPT3001 light sensors.
```
